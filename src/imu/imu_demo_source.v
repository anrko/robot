// SYNTHETIC IMU samples, not real sensor measurements.
// 100 Hz, 10.24 s periodic motion; generated by tools/imu/generate_demo.py.
module imu_demo_source #(
    parameter integer CYCLES_PER_SAMPLE=500000
)(
    input wire clk,input wire rst_n,
    output reg valid,input wire ready,
    output wire signed [31:0] ax,ay,az,wx,wy,wz,
    output wire [31:0] dt_q24
);
    reg [191:0] samples[0:1023];
    reg [191:0] current;
    reg [9:0] address;
    reg [18:0] counter;
    initial $readmemh("src/imu/demo_samples.hex",samples);
    assign {ax,ay,az,wx,wy,wz}=current;
    assign dt_q24=32'd167772; // 0.01 seconds in Q24, matched to sample table.
    always @(posedge clk) begin
        if(!rst_n) begin counter<=0;address<=0;valid<=0;current<=0;end
        else begin
            if(counter==0) begin
                counter<=CYCLES_PER_SAMPLE-1;
                if(!valid) begin current<=samples[address];valid<=1;end
            end else counter<=counter-1'b1;
            if(valid && ready) begin valid<=0;address<=address+1'b1;end
        end
    end
endmodule
